## zephyrproject/build/Kconfig/arch/Kconfig
```kconfig
# Load Zephyr Arch Kconfig descriptions.
osource "C:/Users/Chinmay/Desktop/Chinmay/smart-plant-project/zephyrproject/zephyr/arch/tricore/Kconfig"
osource "C:/Users/Chinmay/Desktop/Chinmay/smart-plant-project/zephyrproject/zephyr/arch/hexagon/Kconfig"
osource "C:/Users/Chinmay/Desktop/Chinmay/smart-plant-project/zephyrproject/zephyr/arch/rx/Kconfig"
osource "C:/Users/Chinmay/Desktop/Chinmay/smart-plant-project/zephyrproject/zephyr/arch/x86/Kconfig"
osource "C:/Users/Chinmay/Desktop/Chinmay/smart-plant-project/zephyrproject/zephyr/arch/xtensa/Kconfig"
osource "C:/Users/Chinmay/Desktop/Chinmay/smart-plant-project/zephyrproject/zephyr/arch/sparc/Kconfig"
osource "C:/Users/Chinmay/Desktop/Chinmay/smart-plant-project/zephyrproject/zephyr/arch/riscv/Kconfig"
osource "C:/Users/Chinmay/Desktop/Chinmay/smart-plant-project/zephyrproject/zephyr/arch/posix/Kconfig"
osource "C:/Users/Chinmay/Desktop/Chinmay/smart-plant-project/zephyrproject/zephyr/arch/openrisc/Kconfig"
osource "C:/Users/Chinmay/Desktop/Chinmay/smart-plant-project/zephyrproject/zephyr/arch/mips/Kconfig"
osource "C:/Users/Chinmay/Desktop/Chinmay/smart-plant-project/zephyrproject/zephyr/arch/arm64/Kconfig"
osource "C:/Users/Chinmay/Desktop/Chinmay/smart-plant-project/zephyrproject/zephyr/arch/arm/Kconfig"
osource "C:/Users/Chinmay/Desktop/Chinmay/smart-plant-project/zephyrproject/zephyr/arch/arc/Kconfig"
```

## zephyrproject/smart-plant/build/Kconfig/boards/Kconfig
```kconfig
# Load Zephyr board Kconfig descriptions.
osource "C:/Users/Chinmay/Desktop/Chinmay/smart-plant-project/zephyrproject/zephyr/boards/espressif/esp32_devkitc/Kconfig"
```

## zephyrproject/smart-plant/build/Kconfig/boards/Kconfig.esp32_devkitc
```kconfig
# Load board Kconfig descriptions.
osource "C:/Users/Chinmay/Desktop/Chinmay/smart-plant-project/zephyrproject/zephyr/boards/espressif/esp32_devkitc/Kconfig.esp32_devkitc"
```
